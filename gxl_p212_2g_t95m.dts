#include "gxl_p212_2g.dts"

/ {
	le-dt-id = "gxl_p212_2g_t95m";
	fd628_dev {
		compatible = "amlogic,fd628_dev";
		status = "okay";
		fd628_gpio_clk = <&gpio_ao GPIOAO_5 GPIO_ACTIVE_HIGH>;
		fd628_gpio_dat = <&gpio_ao GPIOAO_4 GPIO_ACTIVE_HIGH>;
		fd628_gpio_stb = <&gpio_ao GPIOAO_3 GPIO_ACTIVE_HIGH>;
		/* < DHHMM > Order of display chars (D=dots, represented by a single char) */
		fd628_chars = /bits/ 8 <0 1 2 3 4>;
		/* Dot enumeration */
		/* Type 1: Alarm = 0, USB = 1, Play = 2, Pause = 3, Col = 4, Eth = 5, Wifi = 6 */
		/* Type 2: Apps = 0, Setup = 1, USB = 2, Card = 3, Col = 4, HDMI = 5, CVBS = 6 */
		/* Type 3: Power = 2, LAN = 3, Col = 4, Low Wifi = 5, High Wifi = 6 */
		fd628_dot_bits = /bits/ 8 <0 1 2 3 4 5 6>;
		/* Display type			Ctrl.	Flags	Rsrvd.	Type */
		fd628_display_type = /bits/ 8 <	0x00	0x00	0x00	0x01 >;
	};

};
